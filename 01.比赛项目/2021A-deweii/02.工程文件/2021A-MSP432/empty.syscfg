/**
 * @cliArgs --board "/ti/boards/MSP_EXP432E401Y" --product "simplelink_msp432e4_sdk@4.20.00.12"
 * @versions {"tool":"1.10.0+2163"}
 */

/**
 * Import the modules used in this configuration.
 */
const ADC   = scripting.addModule("/ti/drivers/ADC", {}, false);
const ADC1  = ADC.addInstance();
const GPIO  = scripting.addModule("/ti/drivers/GPIO");
const GPIO1 = GPIO.addInstance();
const GPIO2 = GPIO.addInstance();
const GPIO3 = GPIO.addInstance();
const GPIO4 = GPIO.addInstance();
const GPIO5 = GPIO.addInstance();
const RTOS  = scripting.addModule("/ti/drivers/RTOS");
const UART  = scripting.addModule("/ti/drivers/UART", {}, false);
const UART1 = UART.addInstance();

/**
 * Write custom configuration values to the imported modules.
 */
ADC1.$name = "adc1";

GPIO1.$name            = "S1";
GPIO1.$hardware        = system.deviceData.board.components.USR_SW1;
GPIO1.callbackFunction = "S1_Callback_Function";

GPIO2.$name     = "LED1";
GPIO2.$hardware = system.deviceData.board.components.D1;

GPIO3.$name     = "LED2";
GPIO3.$hardware = system.deviceData.board.components.D2;

GPIO4.$name     = "LED_UART";
GPIO4.$hardware = system.deviceData.board.components.D3;

GPIO5.$name            = "S2";
GPIO5.$hardware        = system.deviceData.board.components.USR_SW2;
GPIO5.callbackFunction = "S2_Callback_Function";


UART1.$name     = "USB_UART";
UART1.$hardware = system.deviceData.board.components.XDS110UART;

/**
 * Pinmux solution for unlocked pins/peripherals. This ensures that minor changes to the automatic solver in a future
 * version of the tool will not impact the pinmux you originally saw.  These lines can be completely deleted in order to
 * re-solve from scratch.
 */
ADC1.adc.$suggestSolution             = "ADC1";
ADC1.adc.adcPin.$suggestSolution      = "boosterpack.26";
GPIO1.gpioPin.$suggestSolution        = "expansion.82";
GPIO2.gpioPin.$suggestSolution        = "expansion.87";
GPIO3.gpioPin.$suggestSolution        = "expansion.85";
GPIO4.gpioPin.$suggestSolution        = "expansion.64";
GPIO5.gpioPin.$suggestSolution        = "expansion.84";
RTOS.timer0.resource.$suggestSolution = "Timer0";
UART1.uart.$suggestSolution           = "UART0";
UART1.uart.txPin.$suggestSolution     = "expansion.76";
UART1.uart.rxPin.$suggestSolution     = "expansion.74";
